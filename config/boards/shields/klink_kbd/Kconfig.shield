## config/boards/shields/klink_kbd/Kconfig.shield
```kconfig
# Copyright (c) 2020 The ZMK Contributors
# SPDX-License-Identifier: MIT

config SHIELD_AGAR_MINI_DONGLE
    def_bool $(shields_list_contains,agar_mini_dongle)

config SHIELD_AGAR_MINI_BLE
    def_bool $(shields_list_contains,agar_mini_ble)
```

## config/boards/shields/klink_kbd/boards/klink.conf
```kconfig
# All config for this keyboard
CONFIG_BUILD_OUTPUT_UF2_FAMILY_ID="0x59952840"

CONFIG_SPI=y

#USB
CONFIG_ZMK_USB=y
CONFIG_USB_DEVICE_VID=0x9D5B
CONFIG_USB_DEVICE_PID=0x2561
CONFIG_USB_DEVICE_MANUFACTURER="KBDFans"
CONFIG_ZMK_KEYBOARD_NAME="Agar Mini"

#BLE
CONFIG_ZMK_BLE=y
CONFIG_BT_DEVICE_NAME_MAX=16
#CONFIG_BT_DEVICE_NAME="Agar Mini"
CONFIG_ZMK_BLE_EXPERIMENTAL_CONN=y
CONFIG_BT_CTLR_TX_PWR_PLUS_8=y
CONFIG_ZMK_IDLE_TIMEOUT=30000
CONFIG_ZMK_SLEEP=y
# 30 minutes to sleep
CONFIG_ZMK_IDLE_SLEEP_TIMEOUT=3600000

#
CONFIG_ZMK_HID_CONSUMER_REPORT_USAGES_FULL=y
CONFIG_ZMK_HID_GENERIC_DESKTOP_USAGES_BASIC=y
#CONFIG_ZMK_POINTING=y
CONFIG_ZMK_HID_INDICATORS=y

CONFIG_ZMK_KSCAN_DEBOUNCE_PRESS_MS=3
CONFIG_ZMK_KSCAN_DEBOUNCE_RELEASE_MS=5
```
